/ {
    chosen {
        zmk,kscan = &kscan0;
    };

    kscan0: kscan {
        compatible = "zmk,kscan-gpio-matrix";
        diode-direction = "col2row";

        row-gpios
            = <&gpio1 00 (GPIO_ACTIVE_HIGH | GPIO_PULL_DOWN)> // D6 (P1.00)
            , <&gpio0 11 (GPIO_ACTIVE_HIGH | GPIO_PULL_DOWN)> // D7 (P0.11)
            , <&gpio1 04 (GPIO_ACTIVE_HIGH | GPIO_PULL_DOWN)> // D8 (P1.04)
            ;

        col-gpios
            = <&gpio0 17 GPIO_ACTIVE_HIGH> // D2 (P0.17)
            , <&gpio0 20 GPIO_ACTIVE_HIGH> // D3 (P0.20)
            , <&gpio0 22 GPIO_ACTIVE_HIGH> // D4 (P0.22)
            , <&gpio0 24 GPIO_ACTIVE_HIGH> // D5 (P0.24)
            ;
    };
};
